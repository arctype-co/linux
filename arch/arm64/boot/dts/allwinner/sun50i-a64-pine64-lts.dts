/*
 * SPDX-License-Identifier: (GPL-2.0+ OR MIT)
 *
 * Copyright (c) 2018 ARM Ltd.
 */

#include "sun50i-a64-sopine-baseboard.dts"

/ {
	model = "Pine64 LTS";
	compatible = "pine64,pine64-lts", "allwinner,sun50i-r18",
		     "allwinner,sun50i-a64";
};

/* On Pi-2 connector */
&uart2 {
	pinctrl-names = "default";
	pinctrl-0 = <&uart2_pins>;
	status = "okay";
};

/* On Euler connector */
&uart3 {
	pinctrl-names = "default";
	pinctrl-0 = <&uart3_pins>;
	status = "okay";
};

/* On Euler connector, RTS/CTS optional */
&uart4 {
	pinctrl-names = "default";
	pinctrl-0 = <&uart4_pins>, <&uart4_rts_cts_pins>;
	status = "okay";
};
